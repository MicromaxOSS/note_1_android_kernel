## drivers/input/fingerprint/Kconfig
```kconfig
#
#Fingerprint
#
menu "Fingerprint support"
	depends on INPUT

config MTK_FINGERPRINT_SUPPORT
	bool "Mediatek Fingerprint"
	default n
	help
	  Fingerprint mtk driver enable/disable
	  in the kernel.Say Y here if you want to
	  use mediatek fingerprint driver,fingerprint
	  driver will support fingerprint function

if MTK_FINGERPRINT_SUPPORT
config MTK_FINGERPRINT_SELECT
	string "sensor type"
	default "GF318M"


if MTK_FINGERPRINT_SELECT = "FPC1145"
config FPC_FINGERPRINT
	bool "FPC Fingerprint"
	default y
	help
	  FPC fingerprint FPC's 102x/104x device.
endif

if MTK_FINGERPRINT_SELECT = "GF318M" ||  MTK_FINGERPRINT_SELECT = "GF5216"
config GOODIX_FINGERPRINT
	bool "Goodix Fingerprint"
#prize modify by mhy start
	default n
#prize modify by mhy end
	help
	  Goodix Fingerprint chip GF316M/GF318M/
	  GF3118M/GF518M/GF5118M/GF516M/GF816M/
	  GF3208/GF3206/GF3266/GF3288/GF5206/
	  GF5216/GF5208 TEE driver

config GOODIX_SENSOR_TYPE
	string "SENSOR_TYPE"
	default "GF5216"
	help
	  Must input sensor type, or default is
	  GF316M GF318M GF3118M GF518M GF5118M
	  GF516M GF816M GF3208 GF3206 GF3266
	  GF3288 GF5206 GF5216 GF5208
endif
# begin, prize-pengguangyi-20190121, add for goodix gf5118m fp
config GOODIX_GF5118M_FINGERPRINT
	bool "Goodix GF5118M Fingerprint"
	default n
	---help---
	Goodix Fingerprint chip GF316M/GF318M/GF3118M/GF518M/GF5118M/GF516M/GF816M/GF3208/GF3206/GF3266/GF3288/GF5206 TEE driver
# end, prize-pengguangyi-20190121, add for goodix gf5118m fp

#prize-add-pengzhipeng-20191105-start
if MTK_FINGERPRINT_SELECT = "ft9362"
  config FT9362_FINGERPRINT
     bool "FT9362 Fingerprint"
     default y
     ---help---
     MICROARRAY fingerprint FT9362's device.
endif

if MTK_FINGERPRINT_SELECT = "ft9362_tee"
  config FT9362_FINGERPRINT_TEE
     bool "FT9362 TEE Fingerprint"
     default y
     ---help---
     MICROARRAY fingerprint FT9362 TEE's device.
endif
if MTK_FINGERPRINT_SELECT = "sunwave_driver_all_in_one"
  config MTK_FINGERPRINT_SUNWAVECORP
       bool "Sunwave Fingerprint"
       default y
	---help---
     MICROARRAY fingerprint Sunwave's device.
endif
#prize-add-pengzhipeng-20191105-end

#prize added by huarui, add fp driver, 20190327-start
if MTK_FINGERPRINT_SELECT = "chipone_ree"
config CHIPONE_FINGERPRINT_REE
	bool "CHIPONE Fingerprint"
	default y
	help
	  CHIPONE fingerprint CHIPONE's device.
endif
#prize added by huarui, add tp driver, 20190327-end
#prize-add finger-tangcong-20200715-start
if MTK_FINGERPRINT_SELECT = "betterlife_tee"
config BETTERLIFE_FINGERPRINT
    bool "betterlife Fingerprint"
	default y
	---help---
	betterlife fingerprint.
endif
#prize-add finger-tangcong-20200715-end

#prize add by lipengpeng 20200628 start
if MTK_FINGERPRINT_SELECT = "chipone_tee"
config CHIPONE_FINGERPRINT_TEE
	bool "CHIPONE Fingerprint"
	default y
	help
	  CHIPONE fingerprint CHIPONE's device.
endif
#prize add by lipengpeng 20200628 end


# prize-add-xuxiaoming-20200112-start
source "drivers/input/fingerprint/silead/Kconfig"
# prize-add-xuxiaoming-20200112-end
endif
endmenu
```

## drivers/input/touchscreen/mediatek/goodix_gtx8/Kconfig
```kconfig
#
# Goodix touchscreen driver configuration
#
menuconfig TOUCHSCREEN_GOODIX_GTX8
	bool "Goodix GTx8 touchscreen"
	depends on I2C
# begin, prize-lifenfen-20200411, modify default value for other project compile error
#	default y
       default n
# end, prize-lifenfen-20200411, modify default value for other project compile error
	help
	  Say Y here if you have a Goodix GTx5xx touchscreen connected
	  to your system.

	  If unsure, say N.

if TOUCHSCREEN_GOODIX_GTX8

config TOUCHSCREEN_GOODIX_GTX8_UPDATE
	tristate "Goodix GTx8 firmware update module"
# begin, prize-lifenfen-20200411, modify default value for other project compile error
#       default y
       default n
# end, prize-lifenfen-20200411, modify default value for other project compile error
	help
	  Say Y here to enable support for doing firmware update.

	  If unsure, say N.

	  To compile this driver as a module, choose M here.

config TOUCHSCREEN_GOODIX_GTX8_GESTURE
	tristate "Goodix GTx8 gesture wakeup feature"
# begin, prize-lifenfen-20200411, modify default value for other project compile error
#       default y
       default n
# end, prize-lifenfen-20200411, modify default value for other project compile error
	help
	  Say Y here to enable support for gesture wakeup feature..

	  If unsure, say N.

	  To compile this driver as a module, choose M here.

config TOUCHSCREEN_GOODIX_GTX8_TOOLS
	tristate "Goodix touch tools support"
# begin, prize-lifenfen-20200411, modify default value for other project compile error
#       default y
       default n
# end, prize-lifenfen-20200411, modify default value for other project compile error
	help
	  Say Y here to enable debug tools.

	  If unsure, say N.

	  To compile this driver as a module, choose M here.

endif
```

## drivers/misc/mediatek/prize/Kconfig
```kconfig
config PRIZE_LCD_BIAS
  bool CONFIG_PRIZE_LCD_BIAS
  default no
  help
    CONFIG_PRIZE_LCD_BIAS

# prize-dingjun-20150410-start
config PRIZE_HALL
	bool "hall device"
	default n
	help
	  Select Y to enable hall device support
# prize-dingjun-20150410-end

#prize add by huarui, sos torch , 20200402 start
config PRIZE_TORCH
	bool "torch with fun"
	default n
	help
	  Select Y to enable prize torch
#prize add by huarui, sos torch , 20200402 start

#prize add by huarui, hoperf hp5804 , 20200402 start
config PRIZE_BAROMETER_H5804
	bool "water barometer with h5804"
	default n
	help
	  Select Y to enable water barometer
#prize add by huarui, hoperf hp5804 , 20200402 start

#prize add by huangjiwu, fm ant , 20200720 start
config PRIZE_FM_ANT_SWITCH
	bool "fm ant switch fun"
	default n
	help
	  Select Y to enable prize fm ant switch fun
#prize add by huarui, fm ant switch , 20200720 start
```

## drivers/misc/mediatek/smartpa/Kconfig
```kconfig
config MTK_SMARTPA_SOUND
	bool "MTK sound for external I2C driver"
	default n
	help
	  If you say Y, enable mtk audio i2c driver to control
	  external device for example:smartpa device.

# begin, prize-lifenfen-20181213, add for smartpa awinic aw8898
config SND_SMARTPA_NXP
	bool "MTK sound for external I2C driver"
	default n
	help
	  If you say Y, enable mtk audio i2c driver to control
	  external device for example:smartpa device.

config SND_SMARTPA_AW8898
	tristate "SoC Audio for awinic aw8898 series"
	depends on I2C
	default n
	help
	  This option enables support for aw8898 series Smart PA.

config SND_SMARTPA_AW88194A
	tristate "SoC Audio for awinic aw88194a series"
	depends on I2C
	default n
	help
	  This option enables support for aw88194a series Smart PA.
# end, prize-lifenfen-20181213, add for smartpa awinic aw8898
```

## drivers/power/supply/mediatek/battery/Kconfig
```kconfig
menuconfig MEDIATEK_BATTERY_SOLUTION
	bool "MediaTek Propritary Configuration for Battery"
	help
	  Check this to enable MediaTek Battery configuration.

config MTK_SMART_BATTERY
	bool "MediaTek Smart Battery Driver"
	help
	  Check this to enable MediaTek smart battery driver.
	  The driver supports charging control flow.
	  It maintais both charger and battery status.
	  It also includes Mediatek gas gauge.

config MTK_GAUGE_VERSION
	int "MediaTek Fuel Gauge version"
	default 20
	help
	  Select MTK Gauge Master version
	  30: Gauge Master 3.0

config MTK_DISABLE_GAUGE
	bool "disable Gauge Master 3.0"
	default n
	help
	  Set Yes to disable Gauge Master 3.0
	  under new MTK Charger Framework
	  Set No to enable Gauge Master 3.0
	  under new MTK Charger Framework

config MTK_ADDITIONAL_BATTERY_TABLE
	bool "Enable the fifth battery table"
	default y
	help
	  Set Yes to enable the fifth battery table
	  Table number is five.
	  Set No to disable the fifth battery table
	  Table number is four.

# begin, prize-lifenfen-20181207, add fuel gauge cw2015
config MTK_CW2015_SUPPORT
	bool "Charger Driver for CW2015 fg"
	default n
	help
	  Say Y to enable
	  CW2015 driver.
	  It depends on config MTK_SMART_BATTERY
	  and config MTK_SWCHR_SUPPORT.
# end, prize-lifenfen-20181207, add fuel gauge cw2015

#prize added by huarui, cw2015 support, 20190111-start
config MTK_CW2015_SUPPORT_OF
	bool "Charger Driver for CW2015 fg"
	default n
	select MTK_CW2015_SUPPORT
	help
	  Say Y to enable CW2015 driver.
#prize added by huarui, cw2015 support, 20190111-end
# prize-add-sunshuai-2015 Multi-Battery Solution-20200222-start
config MTK_CW2015_BATTERY_ID_AUXADC
	bool "2015 fuel gauge compatible with multiple batteries"
	default n
	help
	  Say Y to enable
	  Enable 2015 Multi-Battery Solution.
	  It depends on config MTK_CW2015_SUPPORT
	  and config MTK_CW2015_SUPPORT_OF.
# prize-add-sunshuai-2015 Multi-Battery Solution-20200222-end
```
