&i2c3 {
    aw22xxx_led@6a {
        compatible = "awinic,aw22xxx_led";
        reg = <0x6a>;
        reset-gpio = <&pio 63 0>;
        irq-gpio = <&pio 64 0>;
        status = "okay";
        aw22xxx,led {
            aw22xxx,name = "aw22xxx_led";
            aw22xxx,imax = <1>;
            aw22xxx,brightness = <128>;
            aw22xxx,max_brightness = <255>;
        };
    };
};

